## Kconfig
```kconfig
config SOFTSIM
    bool "SoftSIM"
    depends on NVS
    depends on FLASH
    depends on FLASH_MAP
    depends on FLASH_PAGE_LAYOUT
    depends on MPU_ALLOW_FLASH_WRITE
    depends on BUILD_WITH_TFM

if SOFTSIM

config SOFTSIM_AUTO_INIT
    bool "Automatically initialize SoftSIM"
    default y
    help
        Automatically initialize SoftSIM when the modem is powered on.

config SOFTSIM_DEBUG
    bool "Enable debug messages for SoftSIM"
    default n

config SOFTSIM_STATIC_PROFILE_ENABLE
    bool "Enable static profile"
    default n
    help
        Enable static profile to use for SoftSIM. Developement only.

config SOFTSIM_STATIC_PROFILE
    string "Static profile"
    depends on SOFTSIM_STATIC_PROFILE_ENABLE
    help
        Static profile to use for SoftSIM. If empty, the profile should be passed during runtime (just once via nrf_softsim_provision)

config SOFTSIM_BUNDLE_TEMPLATE_HEX
    bool "Automatically bundle the template profile hex into the application"
    default n

config SOFTSIM_FS_BACKEND
    bool "Use FileSystem as the backend for SoftSIM"
    default n
    help
        Use FileSystem as the backend for SoftSIM. 

if SOFTSIM
    config SOFTSIM_FS_BACKEND_PREFIX
        string "Prefix for the storage path for the Filesystem backend"
        default "/storage"
        help
            Prefix for the storage path for the Filesystem backend.

    config SOFTSIM_FS_PATH_LEN
        int "Maximum file path length"
        default 64
        help
            Limits the maximum path length for file operations, in bytes.

    config SOFTSIM_FS_TEMPLATE_GENERATION
        bool "Enable template generation for the Filesystem backend using code"
        default y
        help
            Enable template generation for the Filesystem backend using code.

    config SOFTSIM_FS_BACKUP_PATITION
        bool "Enable backup partition for the Filesystem backend"
        default n
        help
            Enable backup partition for the Filesystem backend.

    if SOFTSIM_FS_BACKUP_PATITION
        config SOFTSIM_FS_BACKUP_PREFIX
            string "Prefix for the backup path for the Filesystem backend"
            default "/backup"
            help
                Prefix for the backup path for the Filesystem backend.
    endif
endif
    
endif #SOFTSIM


module = SOFTSIM
module-str = Onomondo-SoftSIM
source "${ZEPHYR_BASE}/subsys/logging/Kconfig.template.log_config"
```
